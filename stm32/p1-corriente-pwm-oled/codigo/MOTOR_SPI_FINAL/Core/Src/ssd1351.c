#include <ssd1351.h>
#include "main.h"

extern SPI_HandleTypeDef hspi1;
void SSD1351_DrawPixel(uint8_t x, uint8_t y, uint16_t color);


#define DC_GPIO_Port GPIOB
#define DC_Pin GPIO_PIN_1
#define CS_GPIO_Port GPIOE
#define CS_Pin GPIO_PIN_5
#define RST_GPIO_Port GPIOE
#define RST_Pin GPIO_PIN_4

static void SSD1351_SendCommand(uint8_t cmd) {
    HAL_GPIO_WritePin(DC_GPIO_Port, DC_Pin, GPIO_PIN_RESET);
    HAL_GPIO_WritePin(CS_GPIO_Port, CS_Pin, GPIO_PIN_RESET);
    HAL_SPI_Transmit(&hspi1, &cmd, 1, HAL_MAX_DELAY);
    HAL_GPIO_WritePin(CS_GPIO_Port, CS_Pin, GPIO_PIN_SET);
}

static void SSD1351_SendData(uint8_t *data, uint16_t size) {
    HAL_GPIO_WritePin(DC_GPIO_Port, DC_Pin, GPIO_PIN_SET);
    HAL_GPIO_WritePin(CS_GPIO_Port, CS_Pin, GPIO_PIN_RESET);
    HAL_SPI_Transmit(&hspi1, data, size, HAL_MAX_DELAY);
    HAL_GPIO_WritePin(CS_GPIO_Port, CS_Pin, GPIO_PIN_SET);
}

void SSD1351_Init(void) {
    HAL_GPIO_WritePin(RST_GPIO_Port, RST_Pin, GPIO_PIN_RESET);
    HAL_Delay(20);
    HAL_GPIO_WritePin(RST_GPIO_Port, RST_Pin, GPIO_PIN_SET);
    HAL_Delay(20);

    SSD1351_SendCommand(0xAE); // Display off

    SSD1351_SendCommand(0xFD); // Command Lock
    SSD1351_SendData((uint8_t[]){0x12}, 1);

    SSD1351_SendCommand(0xFD); // Command Lock again
    SSD1351_SendData((uint8_t[]){0xB1}, 1);

    SSD1351_SendCommand(0xAE); // Display Off
    SSD1351_SendCommand(0xB3); // Clock Div
    SSD1351_SendData((uint8_t[]){0xF1}, 1);

    SSD1351_SendCommand(0xCA); // MUX Ratio
    SSD1351_SendData((uint8_t[]){0x7F}, 1);

    SSD1351_SendCommand(0xA0); // Set remap and color depth
    SSD1351_SendData((uint8_t[]){0x72}, 1);

    SSD1351_SendCommand(0x15); // Set column address
    SSD1351_SendData((uint8_t[]){0x00, 0x7F}, 2);

    SSD1351_SendCommand(0x75); // Set row address
    SSD1351_SendData((uint8_t[]){0x00, 0x7F}, 2);

    SSD1351_SendCommand(0xA1); // Start line
    SSD1351_SendData((uint8_t[]){0x00}, 1);

    SSD1351_SendCommand(0xA2); // Display offset
    SSD1351_SendData((uint8_t[]){0x00}, 1);

    SSD1351_SendCommand(0xB5); // Set GPIO
    SSD1351_SendData((uint8_t[]){0x00}, 1);

    SSD1351_SendCommand(0xAB); // Function select
    SSD1351_SendData((uint8_t[]){0x01}, 1);

    SSD1351_SendCommand(0xB1); // Precharge
    SSD1351_SendData((uint8_t[]){0x32}, 1);

    SSD1351_SendCommand(0xBE); // VCOMH
    SSD1351_SendData((uint8_t[]){0x05}, 1);

    SSD1351_SendCommand(0xA6); // Normal display

    SSD1351_SendCommand(0xC1); // Contrast
    SSD1351_SendData((uint8_t[]){0xC8, 0x80, 0xC8}, 3);

    SSD1351_SendCommand(0xC7); // Master contrast
    SSD1351_SendData((uint8_t[]){0x0F}, 1);

    SSD1351_SendCommand(0xB4); // Set segment low voltage
    SSD1351_SendData((uint8_t[]){0xA0, 0xB5, 0x55}, 3);

    SSD1351_SendCommand(0xB6); // Second precharge
    SSD1351_SendData((uint8_t[]){0x01}, 1);

    SSD1351_SendCommand(0xAF); // Display on
}

void SSD1351_Clear(void) {
    SSD1351_SendCommand(0x15);
    SSD1351_SendData((uint8_t[]){0x00, 0x7F}, 2);
    SSD1351_SendCommand(0x75);
    SSD1351_SendData((uint8_t[]){0x00, 0x7F}, 2);
    SSD1351_SendCommand(0x5C);
    uint8_t black[] = {0x00, 0x00};
    for (uint16_t i = 0; i < 128 * 128; i++) {
        SSD1351_SendData(black, 2);
    }
}

void SSD1351_DrawPixel(uint8_t x, uint8_t y, uint16_t color) {
    if (x >= SSD1351_WIDTH || y >= SSD1351_HEIGHT) return;

    SSD1351_SendCommand(0x15); // Set column address
    SSD1351_SendData((uint8_t[]){x, x}, 2);

    SSD1351_SendCommand(0x75); // Set row address
    SSD1351_SendData((uint8_t[]){y, y}, 2);

    SSD1351_SendCommand(0x5C); // Write RAM
    uint8_t data[2] = {color >> 8, color & 0xFF}; // RGB565
    SSD1351_SendData(data, 2);
}


const uint8_t font5x8[][5] = {
    {0x00,0x00,0x00,0x00,0x00}, // 32 ' '
    {0x00,0x00,0x5F,0x00,0x00}, // 33 '!'
    {0x00,0x07,0x00,0x07,0x00}, // 34 '"'
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    {0x44,0x64,0x54,0x4C,0x44}  // 122 'z'
};


void SSD1351_DrawText(uint8_t x, uint8_t y, const char *text,
                      uint16_t color, uint16_t bg, uint8_t scale) {
    while (*text) {
        char c = *text++;
        if (c < 32 || c > 127) c = '?';
        const uint8_t *bitmap = font5x8[c - 32];

        for (uint8_t col = 0; col < 5; col++) {
            uint8_t line = bitmap[col];
            for (uint8_t row = 0; row < 8; row++) {
                uint16_t px = x + col * scale;
                uint16_t py = y + row * scale;
                for (uint8_t dx = 0; dx < scale; dx++) {
                    for (uint8_t dy = 0; dy < scale; dy++) {
                        if (line & 0x01)
                            SSD1351_DrawPixel(px + dx, py + dy, color);
                        else
                            SSD1351_DrawPixel(px + dx, py + dy, bg);
                    }
                }
                line >>= 1;
            }
        }
        x += 6 * scale;
    }
}


