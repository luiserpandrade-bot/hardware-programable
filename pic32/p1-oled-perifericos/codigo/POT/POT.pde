// ========== Config pines (exactamente los tuyos) ==========
#define LED1 77       // LED controlado por SWITCH_PIN (forzado por el switch)
#define LED2 76       // LED secuencia
#define LED3 75       // LED secuencia
#define LED4 74       // LED controlado por BUTTON_PIN (encendido mientras se pulsa)

#define SWITCH_PIN 79 // Switch de 2 posiciones: nivel 1 o 0 (forza LED1)
#define BUTTON_PIN 78 // Botón momentáneo: mientras esté pulsado -> LED4 ON

// OLED SPI pins (bit-bang)
#define OLED_RES 10   // RESET
#define OLED_DC  83   // D/C (0 = command, 1 = data)
#define OLED_SCLK 13  // SCLK
#define OLED_SDIN 11  // MOSI (SDIN)
// VDD = 82, VBAT = 84  -> ADVERTENCIA: no conectes VDD/VBAT a GPIO a menos que estés seguro.

#define STEP_DELAY 500  // ms secuencia

// ================= FONT 5x8 ASCII completo (0x20..0x7F) ==================
// Cada carácter ocupa 5 columnas; fuente estándar 5x8 (adaptada de fuentes públicas).
const uint8_t font5x8_custom[][5] = {
  {0x00,0x00,0x00,0x00,0x00}, // 0x20 ' '
  {0x00,0x00,0x5F,0x00,0x00}, // 0x21 '!'
  {0x00,0x07,0x00,0x07,0x00}, // 0x22 '"'
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  {0x10,0x08,0x08,0x10,0x08}  // 0x7E '~' (approx)
};
// ========================================================================

// Map char -> index in font5x8_custom (ASCII 0x20..0x7F)
int char_index(char c) {
  if (c >= 0x20 && c <= 0x7E) return (c - 0x20);
  return 0; // fallback: space
}

// ========== Rutinas SPI por bit-bang para OLED ==========
void oled_pin_init() {
  pinMode(OLED_RES, OUTPUT);
  pinMode(OLED_DC, OUTPUT);
  pinMode(OLED_SCLK, OUTPUT);
  pinMode(OLED_SDIN, OUTPUT);
}

void spi_delay() {
  asm volatile("nop"); asm volatile("nop");
}

void spi_write_byte(uint8_t b) {
  for (int i = 7; i >= 0; --i) {
    digitalWrite(OLED_SCLK, LOW);
    if (b & (1 << i)) digitalWrite(OLED_SDIN, HIGH);
    else digitalWrite(OLED_SDIN, LOW);
    spi_delay();
    digitalWrite(OLED_SCLK, HIGH);
    spi_delay();
  }
  digitalWrite(OLED_SCLK, LOW);
}

void oled_write_command(uint8_t cmd) {
  digitalWrite(OLED_DC, LOW);
  spi_write_byte(cmd);
}

void oled_write_data(uint8_t data) {
  digitalWrite(OLED_DC, HIGH);
  spi_write_byte(data);
}

void oled_init() {
  oled_pin_init();
  digitalWrite(OLED_RES, LOW);
  delay(10);
  digitalWrite(OLED_RES, HIGH);
  delay(10);

  oled_write_command(0xAE);
  oled_write_command(0xD5); oled_write_command(0x80);
  oled_write_command(0xA8); oled_write_command(0x1F);
  oled_write_command(0xD3); oled_write_command(0x00);
  oled_write_command(0x40);
  oled_write_command(0x8D); oled_write_command(0x14);
  oled_write_command(0x20); oled_write_command(0x00);
  oled_write_command(0xA1);
  oled_write_command(0xC8);
  oled_write_command(0xDA); oled_write_command(0x02);
  oled_write_command(0x81); oled_write_command(0x8F);
  oled_write_command(0xD9); oled_write_command(0xF1);
  oled_write_command(0xDB); oled_write_command(0x40);
  oled_write_command(0xA4);
  oled_write_command(0xA6);
  oled_write_command(0xAF);
}

void oled_set_pos(uint8_t col, uint8_t page) {
  oled_write_command(0xB0 | page);
  oled_write_command(0x00 | (col & 0x0F));
  oled_write_command(0x10 | ((col >> 4) & 0x0F));
}

void oled_draw_text_simple(uint8_t x, uint8_t page, const char *s) {
  uint8_t col = x;
  while (*s && col < 128) {
    int idx = char_index(*s);
    const uint8_t *glyph = font5x8_custom[idx];
    oled_set_pos(col, page);
    for (int i = 0; i < 5; ++i) {
      oled_write_data(glyph[i]);
    }
    oled_write_data(0x00); // espacio entre caracteres
    col += 6;
    s++;
  }
}

void oled_clear() {
  for (uint8_t page = 0; page < 4; ++page) {
    oled_set_pos(0, page);
    for (uint8_t col = 0; col < 128; ++col) {
      oled_write_data(0x00);
    }
  }
}

void oled_clear_line(uint8_t page) {
  oled_set_pos(0, page);
  for (uint8_t col = 0; col < 128; ++col) {
    oled_write_data(0x00);
  }
}

char *int_to_str(int val, char *buf) {
  char tmp[12];
  int i = 0;
  if (val == 0) {
    buf[0] = '0';
    buf[1] = '\0';
    return buf;
  }
  while (val > 0 && i < 11) {
    tmp[i++] = '0' + (val % 10);
    val /= 10;
  }
  int j;
  for (j = 0; j < i; ++j) buf[j] = tmp[i - 1 - j];
  buf[j] = '\0';
  return buf;
}

// ========== Setup y loop principales ==========
void setup() {
  pinMode(LED1, OUTPUT);
  pinMode(LED2, OUTPUT);
  pinMode(LED3, OUTPUT);
  pinMode(LED4, OUTPUT);

  pinMode(SWITCH_PIN, INPUT);
  pinMode(BUTTON_PIN, INPUT);

  pinMode(A0, INPUT);

  digitalWrite(LED1, LOW);
  digitalWrite(LED2, LOW);
  digitalWrite(LED3, LOW);
  digitalWrite(LED4, LOW);

  oled_init();
  oled_clear();
  // Texto cambiado:
  oled_draw_text_simple(0, 0, "Lectura de Pot.");
}

void loop() {
  int switchState = digitalRead(SWITCH_PIN);
  if (switchState == HIGH) digitalWrite(LED1, HIGH);
  else digitalWrite(LED1, LOW);

  int buttonState = digitalRead(BUTTON_PIN);
  if (buttonState == HIGH) digitalWrite(LED4, HIGH);
  else digitalWrite(LED4, LOW);

  digitalWrite(LED2, HIGH);
  digitalWrite(LED3, LOW);
  delay(STEP_DELAY);

  digitalWrite(LED2, LOW);
  digitalWrite(LED3, HIGH);
  delay(STEP_DELAY);

  digitalWrite(LED2, LOW);
  digitalWrite(LED3, LOW);
  delay(STEP_DELAY);

  // Lectura A0 y mostrar en OLED en la página 2
  int reading = analogRead(A0); // suponemos 10-bit (0..1023)
  int mv = (reading * 3300) / 1023; // mV

  char buf[24];
  char num1[12], num2[12];
  int_to_str(reading, num1);
  int_to_str(mv, num2);

  int pos = 0;
  for (int i = 0; num1[i] != '\0'; ++i) buf[pos++] = num1[i];
  buf[pos++] = ' ';
  for (int i = 0; num2[i] != '\0'; ++i) buf[pos++] = num2[i];
  buf[pos++] = 'm';
  buf[pos++] = 'V';
  buf[pos] = '\0';

  oled_clear_line(2);
  oled_draw_text_simple(0, 2, buf);

  delay(200);
}

